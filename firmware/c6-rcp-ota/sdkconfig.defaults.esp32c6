## firmware/c6-rcp-ota/sdkconfig.defaults.esp32c6
```kconfig
# UART1 via native USB connector: D+ TX13, D- RX12.
CONFIG_OPENTHREAD_UART_PIN_MANUAL=y
CONFIG_OPENTHREAD_UART_TX_PIN=13
CONFIG_OPENTHREAD_UART_RX_PIN=12
CONFIG_ESP_CONSOLE_UART_DEFAULT=y
CONFIG_ESP_CONSOLE_USB_SERIAL_JTAG=n
CONFIG_ESP_CONSOLE_USB_CDC=n
CONFIG_ESP_CONSOLE_UART_CUSTOM=n
CONFIG_ESP_CONSOLE_NONE=n
CONFIG_ESP_CONSOLE_SECONDARY_NONE=y
CONFIG_ESP_CONSOLE_SECONDARY_USB_SERIAL_JTAG=n
CONFIG_ESP_CONSOLE_USB_SERIAL_JTAG_ENABLED=n
CONFIG_ESP_CONSOLE_UART_NUM=0
CONFIG_ESP_CONSOLE_UART_BAUDRATE=115200
```

## firmware/controller/main/Kconfig.projbuild
```kconfig
menu "Matter2Supla gateway"

    config M2S_SINGLE_USB_RCP_OTA
        bool "Single USB-C build: remote ESP32-C6 RCP OTA over UART1"
        default n
        help
            Enables the /api/gateway/update-rcp endpoint and the boot-time
            transfer of a staged, signed C6 RCP image (M2SRCP1) over UART1.
            Requires the C6 to run the 2xOTA RCP firmware from
            firmware/c6-rcp-ota. The firmware version gets
            the "-singleusb" suffix and FW_BUILD_BASE + 1, so both variants
            never share one build number.

endmenu
```
